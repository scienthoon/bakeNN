## CMakeLists.txt
```
cmake_minimum_required(VERSION 3.20.0)

find_package(Zephyr REQUIRED HINTS $ENV{ZEPHYR_BASE})
project(bakenn_tflm_comparison C CXX)

set(NO_THREADSAFE_STATICS $<TARGET_PROPERTY:compiler-cpp,no_threadsafe_statics>)
zephyr_compile_options($<$<COMPILE_LANGUAGE:CXX>:${NO_THREADSAFE_STATICS}>)
target_sources(app PRIVATE src/main.cpp src/model_data.cc)

# Zephyr's TFLM module ships the reference kernels but does not expose the
# TFLM `OPTIMIZED_KERNEL_DIR=cmsis_nn` switch.  Keep the default build
# reference-only and make CMSIS-NN an explicit, reproducible opt-in.
#
# BAKENN_CMSIS_NN_ROOT must point at a pinned CMSIS-NN checkout.  The optional
# BAKENN_CMSIS_CORE_ROOT points at CMSIS/Core/Include (the Zephyr CMSIS module
# is a convenient source on Arm boards).  All CMSIS-NN sources are compiled
# into this image with section GC enabled by the target toolchain; unused
# kernels therefore do not become part of the final ELF.
set(BAKENN_CMSIS_NN_ROOT "" CACHE PATH "Pinned CMSIS-NN checkout")
set(BAKENN_CMSIS_CORE_ROOT "" CACHE PATH "CMSIS Core/Include directory")
set(BAKENN_TFLM_ROOT "" CACHE PATH "TFLM checkout containing the CMSIS-NN wrapper")
option(BAKENN_USE_CMSIS_NN "Use TFLM CMSIS-NN wrappers and kernels" OFF)

if(BAKENN_USE_CMSIS_NN)
  if(NOT BAKENN_CMSIS_NN_ROOT OR NOT EXISTS
     "${BAKENN_CMSIS_NN_ROOT}/Include/arm_nnfunctions.h")
    message(FATAL_ERROR
      "BAKENN_USE_CMSIS_NN requires BAKENN_CMSIS_NN_ROOT with Include/arm_nnfunctions.h")
  endif()
  if(NOT BAKENN_CMSIS_CORE_ROOT OR NOT EXISTS
     "${BAKENN_CMSIS_CORE_ROOT}/cmsis_compiler.h")
    message(FATAL_ERROR
      "BAKENN_USE_CMSIS_NN requires BAKENN_CMSIS_CORE_ROOT/CMSIS/Core/Include")
  endif()
  if(NOT BAKENN_TFLM_ROOT OR NOT EXISTS
     "${BAKENN_TFLM_ROOT}/tensorflow/lite/micro/kernels/cmsis_nn/fully_connected.cc")
    message(FATAL_ERROR
      "BAKENN_USE_CMSIS_NN requires BAKENN_TFLM_ROOT with the cmsis_nn wrapper")
  endif()
  if(NOT EXISTS
     "${BAKENN_TFLM_ROOT}/tensorflow/lite/micro/kernels/cmsis_nn/conv.cc")
    message(FATAL_ERROR
      "BAKENN_USE_CMSIS_NN requires the TFLM cmsis_nn Conv2D wrapper")
  endif()

  # The pinned TFLM wrapper uses the historical CMSIS/NN/Include path.  Keep
  # that compatibility path in the build tree instead of patching vendored
  # TFLM sources or relying on a user's global include tree.
  set(BAKENN_CMSIS_COMPAT_ROOT
      "${CMAKE_BINARY_DIR}/bakenn_cmsis_compat/CMSIS/NN")
  file(MAKE_DIRECTORY "${BAKENN_CMSIS_COMPAT_ROOT}")
  file(CREATE_LINK "${BAKENN_CMSIS_NN_ROOT}/Include"
       "${BAKENN_CMSIS_COMPAT_ROOT}/Include" SYMBOLIC COPY_ON_ERROR)

  file(GLOB_RECURSE BAKENN_CMSIS_NN_SOURCES CONFIGURE_DEPENDS
       "${BAKENN_CMSIS_NN_ROOT}/Source/*.c")
  if(NOT BAKENN_CMSIS_NN_SOURCES)
    message(FATAL_ERROR "No CMSIS-NN C sources found under ${BAKENN_CMSIS_NN_ROOT}/Source")
  endif()

  set(BAKENN_CMSIS_FC_WRAPPER
      "${BAKENN_TFLM_ROOT}/tensorflow/lite/micro/kernels/cmsis_nn/fully_connected.cc")
  set(BAKENN_CMSIS_CONV_WRAPPER
      "${BAKENN_TFLM_ROOT}/tensorflow/lite/micro/kernels/cmsis_nn/conv.cc")
  # Zephyr's module already compiles the reference fully_connected.cc.  The
  # CMSIS wrapper exports the same generic registration symbol, so rename only
  # that unused entry point in the wrapper translation unit and explicitly use
  # its Register_FULLY_CONNECTED_INT8() entry from main.cpp.
  set_source_files_properties(${BAKENN_CMSIS_FC_WRAPPER}
    PROPERTIES COMPILE_DEFINITIONS
      "Register_FULLY_CONNECTED=Register_FULLY_CONNECTED_CMSIS_NN")
  set_source_files_properties(${BAKENN_CMSIS_CONV_WRAPPER}
    PROPERTIES COMPILE_DEFINITIONS
      "Register_CONV_2D=Register_CONV_2D_CMSIS_NN")
  target_sources(app PRIVATE ${BAKENN_CMSIS_FC_WRAPPER}
    ${BAKENN_CMSIS_CONV_WRAPPER}
    ${BAKENN_CMSIS_NN_SOURCES})
  target_include_directories(app PRIVATE
    "${CMAKE_BINARY_DIR}/bakenn_cmsis_compat"
    "${BAKENN_CMSIS_NN_ROOT}/Include"
    "${BAKENN_CMSIS_CORE_ROOT}")
  # The pinned 2021 TFLM wrapper still names the old ARM_MATH_SUCCESS status;
  # CMSIS-NN v4 renamed it to ARM_CMSIS_NN_SUCCESS.  Keep the compatibility
  # shim local to this opt-in target rather than modifying vendored sources.
  target_compile_definitions(app PRIVATE CMSIS_NN BAKENN_USE_CMSIS_NN
    ARM_MATH_SUCCESS=ARM_CMSIS_NN_SUCCESS)
endif()

# The Zephyr 2.7 TFLM headers contain intentionally unused virtual parameters.
# Keep warnings fatal for the runner while suppressing only that upstream case.
target_compile_options(app PRIVATE -Wall -Wextra -Werror -Wno-unused-parameter)
```

## prj.conf
```kconfig
CONFIG_CPLUSPLUS=y
CONFIG_LIB_CPLUSPLUS=y
CONFIG_NEWLIB_LIBC=y
CONFIG_TENSORFLOW_LITE_MICRO=y
CONFIG_CONSOLE=y
CONFIG_UART_CONSOLE=y
CONFIG_SERIAL=y
CONFIG_PRINTK=y
CONFIG_TIMING_FUNCTIONS=y
CONFIG_THREAD_STACK_INFO=y
CONFIG_INIT_STACKS=y
CONFIG_MAIN_STACK_SIZE=4096
CONFIG_SPEED_OPTIMIZATIONS=y
```

## src/main.cpp
```c
#include "model_data.h"

#include <cinttypes>
#include <cstddef>
#include <cstdint>

extern "C" {
#if defined(__has_include)
#if __has_include(<zephyr/kernel.h>)
#include <zephyr/kernel.h>
#include <zephyr/sys/printk.h>
#include <zephyr/timing/timing.h>
#else
#include <kernel.h>
#include <sys/printk.h>
#include <timing/timing.h>
#endif
#endif
}

#include <tensorflow/lite/micro/micro_error_reporter.h>
#include <tensorflow/lite/micro/micro_interpreter.h>
#include <tensorflow/lite/micro/micro_mutable_op_resolver.h>
#if defined(BAKENN_USE_CMSIS_NN)
#include <tensorflow/lite/micro/kernels/fully_connected.h>
namespace tflite {
TfLiteRegistration Register_CONV_2D_CMSIS_NN();
}
#endif
#include <tensorflow/lite/schema/schema_generated.h>

namespace {

// An 8 KiB probe reported 564 used bytes, but this 2021 TFLM allocator could
// not re-create the graph in used+16 bytes: the smaller arena changed tail
constexpr std::size_t kWarmupRuns = 8u;
constexpr std::size_t kMeasuredRuns = 101u;

alignas(16) std::uint8_t tensor_arena[2048u];
std::uint64_t measured_cycles[kMeasuredRuns];

void SortCycles(std::uint64_t *values, std::size_t count) {
  for (std::size_t index = 1u; index < count; ++index) {
    const std::uint64_t value = values[index];
    std::size_t position = index;
    while (position > 0u && values[position - 1u] > value) {
      values[position] = values[position - 1u];
      --position;
    }
    values[position] = value;
  }
}

}  // namespace

int main() {
  static tflite::MicroErrorReporter error_reporter;
#if defined(BAKENN_USE_CMSIS_NN)
  printk("TFLM_BACKEND=CMSIS_NN\n");
#else
  printk("TFLM_BACKEND=REFERENCE\n");
#endif
  const tflite::Model *model = tflite::GetModel(tflm_model_data);
  if (model->version() != TFLITE_SCHEMA_VERSION) {
    printk("TFLM_ERROR schema=%d expected=%d\n", model->version(), TFLITE_SCHEMA_VERSION);
    return 1;
  }

  static tflite::MicroMutableOpResolver<2> resolver;
#if defined(BAKENN_USE_CMSIS_NN)
  if (resolver.AddFullyConnected(tflite::Register_FULLY_CONNECTED_INT8()) !=
      kTfLiteOk) {
    printk("TFLM_ERROR cmsis_nn_fc_resolver\n");
    return 1;
  }
#else
  if (resolver.AddFullyConnected() != kTfLiteOk) {
    printk("TFLM_ERROR resolver\n");
    return 1;
  }
#endif
#if defined(BAKENN_USE_CMSIS_NN)
  if (resolver.AddConv2D(tflite::Register_CONV_2D_CMSIS_NN()) != kTfLiteOk) {
    printk("TFLM_ERROR cmsis_nn_conv_resolver\n");
    return 1;
  }
#else
  if (resolver.AddConv2D() != kTfLiteOk) {
    printk("TFLM_ERROR conv_resolver\n");
    return 1;
  }
#endif
  static tflite::MicroInterpreter interpreter(
      model, resolver, tensor_arena, tflm_model_arena_size, &error_reporter);
  if (interpreter.AllocateTensors() != kTfLiteOk) {
    printk("TFLM_ERROR allocate arena_bytes=%u\n", tflm_model_arena_size);
    return 1;
  }

  TfLiteTensor *input = interpreter.input(0);
  TfLiteTensor *output = interpreter.output(0);
  for (std::size_t index = 0u; index < tflm_model_input_count; ++index) {
    input->data.int8[index] = static_cast<std::int8_t>(input->params.zero_point);
  }

  timing_init();
  timing_start();
  timing_t start = timing_counter_get();
  TfLiteStatus status = interpreter.Invoke();
  timing_t end = timing_counter_get();
  const std::uint64_t first_cycles = timing_cycles_get(&start, &end);
  if (status != kTfLiteOk) {
    printk("TFLM_ERROR first_invoke\n");
    return 1;
  }

  for (std::size_t run = 0u; run < kWarmupRuns; ++run) {
    if (interpreter.Invoke() != kTfLiteOk) {
      printk("TFLM_ERROR warmup\n");
      return 1;
    }
  }
  for (std::size_t run = 0u; run < kMeasuredRuns; ++run) {
    start = timing_counter_get();
    status = interpreter.Invoke();
    end = timing_counter_get();
    if (status != kTfLiteOk) {
      printk("TFLM_ERROR invoke run=%u\n", static_cast<unsigned>(run));
      return 1;
    }
    measured_cycles[run] = timing_cycles_get(&start, &end);
  }
  timing_stop();
  SortCycles(measured_cycles, kMeasuredRuns);

  std::size_t stack_unused = 0u;
  const int stack_status = k_thread_stack_space_get(k_current_get(), &stack_unused);
  printk("TFLM target=nrf52840dk runs=%u first_cycles=%" PRIu64
         " median_cycles=%" PRIu64 " p95_cycles=%" PRIu64
         " tensor_arena_bytes=%u tensor_arena_used_bytes=%u"
         " stack_unused_bytes=%zu stack_status=%d\n",
         static_cast<unsigned>(kMeasuredRuns), first_cycles, measured_cycles[50],
         measured_cycles[95], tflm_model_arena_size,
         static_cast<unsigned>(interpreter.arena_used_bytes()), stack_unused, stack_status);
  std::uint32_t output_checksum = 2166136261u;
  for (std::size_t index = 0u; index < tflm_model_output_count; ++index) {
    output_checksum ^= static_cast<std::uint8_t>(output->data.int8[index]);
    output_checksum *= 16777619u;
  }
  printk("TFLM_OUTPUT_FNV1A=0x%08x first", output_checksum);
  const std::size_t preview = tflm_model_output_count < 8u ? tflm_model_output_count : 8u;
  for (std::size_t index = 0u; index < preview; ++index) {
    printk(" %d", static_cast<int>(output->data.int8[index]));
  }
  printk("\n");
  return 0;
}
```

## src/model_data.cc
```c
#include "model_data.h"

alignas(8) const unsigned char tflm_model_data[] = {
    0x08, 0x00, 0x00, 0x00, 0x54, 0x46, 0x4c, 0x33, 0x7e, 0xff, 0xff, 0xff,
    0x3c, 0x00, 0x00, 0x00, 0x10, 0x00, 0x00, 0x00, 0x4c, 0x00, 0x00, 0x00,
    0x50, 0x00, 0x00, 0x00, 0x03, 0x00, 0x00, 0x00, 0x23, 0x00, 0x00, 0x00,
    0x42, 0x61, 0x6b, 0x65, 0x4e, 0x4e, 0x20, 0x74, 0x61, 0x72, 0x67, 0x65,
    0x74, 0x2d, 0x73, 0x6d, 0x6f, 0x6b, 0x65, 0x20, 0x54, 0x46, 0x4c, 0x4d,
    0x20, 0x63, 0x6f, 0x6d, 0x70, 0x61, 0x72, 0x69, 0x73, 0x6f, 0x6e, 0x00,
    0x05, 0x00, 0x00, 0x00, 0x28, 0x08, 0x00, 0x00, 0x14, 0x06, 0x00, 0x00,
    0xbc, 0x05, 0x00, 0x00, 0x6c, 0x05, 0x00, 0x00, 0x4c, 0x05, 0x00, 0x00,
    0x01, 0x00, 0x00, 0x00, 0x34, 0x00, 0x00, 0x00, 0x01, 0x00, 0x00, 0x00,
    0x10, 0x00, 0x00, 0x00, 0x0c, 0x00, 0x0e, 0x00, 0x0d, 0x00, 0x00, 0x00,
    0x04, 0x00, 0x08, 0x00, 0x0c, 0x00, 0x00, 0x00, 0x04, 0x00, 0x00, 0x00,
    0x09, 0x00, 0x00, 0x00, 0x00, 0x09, 0x0e, 0x00, 0x18, 0x00, 0x14, 0x00,
    0x10, 0x00, 0x0c, 0x00, 0x08, 0x00, 0x04, 0x00, 0x0e, 0x00, 0x00, 0x00,
    0x14, 0x00, 0x00, 0x00, 0x24, 0x00, 0x00, 0x00, 0x2c, 0x00, 0x00, 0x00,
    0x30, 0x00, 0x00, 0x00, 0x34, 0x00, 0x00, 0x00, 0x0c, 0x00, 0x00, 0x00,
    0x74, 0x61, 0x72, 0x67, 0x65, 0x74, 0x5f, 0x73, 0x6d, 0x6f, 0x6b, 0x65,
    0x00, 0x00, 0x00, 0x00, 0x02, 0x00, 0x00, 0x00, 0x88, 0x00, 0x00, 0x00,
    0x44, 0x00, 0x00, 0x00, 0x01, 0x00, 0x00, 0x00, 0x06, 0x00, 0x00, 0x00,
    0x01, 0x00, 0x00, 0x00, 0x00, 0x00, 0x00, 0x00, 0x07, 0x00, 0x00, 0x00,
    0x6c, 0x04, 0x00, 0x00, 0x50, 0x03, 0x00, 0x00, 0x34, 0x02, 0x00, 0x00,
    0xdc, 0x01, 0x00, 0x00, 0x5c, 0x01, 0x00, 0x00, 0xe0, 0x00, 0x00, 0x00,
    0x90, 0x00, 0x00, 0x00, 0x00, 0x00, 0x0e, 0x00, 0x14, 0x00, 0x00, 0x00,
    0x10, 0x00, 0x0c, 0x00, 0x0b, 0x00, 0x04, 0x00, 0x0e, 0x00, 0x00, 0x00,
    0x10, 0x00, 0x00, 0x00, 0x00, 0x00, 0x00, 0x08, 0x0c, 0x00, 0x00, 0x00,
    0x10, 0x00, 0x00, 0x00, 0xb4, 0xf8, 0xff, 0xff, 0x01, 0x00, 0x00, 0x00,
    0x06, 0x00, 0x00, 0x00, 0x03, 0x00, 0x00, 0x00, 0x03, 0x00, 0x00, 0x00,
    0x04, 0x00, 0x00, 0x00, 0x05, 0x00, 0x00, 0x00, 0x00, 0x00, 0x0e, 0x00,
    0x16, 0x00, 0x00, 0x00, 0x10, 0x00, 0x0c, 0x00, 0x0b, 0x00, 0x04, 0x00,
    0x0e, 0x00, 0x00, 0x00, 0x18, 0x00, 0x00, 0x00, 0x00, 0x00, 0x00, 0x08,
    0x18, 0x00, 0x00, 0x00, 0x1c, 0x00, 0x00, 0x00, 0x00, 0x00, 0x06, 0x00,
    0x08, 0x00, 0x07, 0x00, 0x06, 0x00, 0x00, 0x00, 0x00, 0x00, 0x00, 0x01,
    0x01, 0x00, 0x00, 0x00, 0x03, 0x00, 0x00, 0x00, 0x03, 0x00, 0x00, 0x00,
    0x00, 0x00, 0x00, 0x00, 0x01, 0x00, 0x00, 0x00, 0x02, 0x00, 0x00, 0x00,
    0x4a, 0xfc, 0xff, 0xff, 0x10, 0x00, 0x00, 0x00, 0x38, 0x00, 0x00, 0x00,
    0x00, 0x00, 0x00, 0x09, 0x24, 0x00, 0x00, 0x00, 0x3c, 0xfc, 0xff, 0xff,
    0x08, 0x00, 0x00, 0x00, 0x10, 0x00, 0x00, 0x00, 0x01, 0x00, 0x00, 0x00,
    0xfd, 0xff, 0xff, 0xff, 0xff, 0xff, 0xff, 0xff, 0x01, 0x00, 0x00, 0x00,
    0x67, 0x50, 0x82, 0x3c, 0x02, 0x00, 0x00, 0x00, 0x01, 0x00, 0x00, 0x00,
    0x04, 0x00, 0x00, 0x00, 0x06, 0x00, 0x00, 0x00, 0x6f, 0x75, 0x74, 0x70,
    0x75, 0x74, 0x00, 0x00, 0xae, 0xfd, 0xff, 0xff, 0x14, 0x00, 0x00, 0x00,
    0x60, 0x00, 0x00, 0x00, 0x04, 0x00, 0x00, 0x00, 0x00, 0x00, 0x00, 0x02,
    0x4c, 0x00, 0x00, 0x00, 0x8c, 0xfc, 0xff, 0xff, 0x08, 0x00, 0x00, 0x00,
    0x2c, 0x00, 0x00, 0x00, 0x04, 0x00, 0x00, 0x00, 0x00, 0x00, 0x00, 0x00,
    0x00, 0x00, 0x00, 0x00, 0x00, 0x00, 0x00, 0x00, 0x00, 0x00, 0x00, 0x00,
    0x00, 0x00, 0x00, 0x00, 0x00, 0x00, 0x00, 0x00, 0x00, 0x00, 0x00, 0x00,
    0x00, 0x00, 0x00, 0x00, 0x00, 0x00, 0x00, 0x00, 0x04, 0x00, 0x00, 0x00,
    0x6b, 0x20, 0xf1, 0x37, 0x6b, 0x20, 0xf1, 0x37, 0x6b, 0x20, 0xf1, 0x37,
    0x6b, 0x20, 0xf1, 0x37, 0x01, 0x00, 0x00, 0x00, 0x04, 0x00, 0x00, 0x00,
    0x0b, 0x00, 0x00, 0x00, 0x6f, 0x75, 0x74, 0x70, 0x75, 0x74, 0x2e, 0x62,
    0x69, 0x61, 0x73, 0x00, 0x26, 0xfe, 0xff, 0xff, 0x14, 0x00, 0x00, 0x00,
    0x60, 0x00, 0x00, 0x00, 0x03, 0x00, 0x00, 0x00, 0x00, 0x00, 0x00, 0x09,
    0x48, 0x00, 0x00, 0x00, 0x04, 0xfd, 0xff, 0xff, 0x08, 0x00, 0x00, 0x00,
    0x28, 0x00, 0x00, 0x00, 0x04, 0x00, 0x00, 0x00, 0x00, 0x00, 0x00, 0x00,
    0x00, 0x00, 0x00, 0x00, 0x00, 0x00, 0x00, 0x00, 0x00, 0x00, 0x00, 0x00,
    0x00, 0x00, 0x00, 0x00, 0x00, 0x00, 0x00, 0x00, 0x00, 0x00, 0x00, 0x00,
    0x00, 0x00, 0x00, 0x00, 0x04, 0x00, 0x00, 0x00, 0x5c, 0x03, 0x57, 0x3b,
    0x5c, 0x03, 0x57, 0x3b, 0x5c, 0x03, 0x57, 0x3b, 0x5c, 0x03, 0x57, 0x3b,
    0x02, 0x00, 0x00, 0x00, 0x04, 0x00, 0x00, 0x00, 0x10, 0x00, 0x00, 0x00,
    0x0d, 0x00, 0x00, 0x00, 0x6f, 0x75, 0x74, 0x70, 0x75, 0x74, 0x2e, 0x77,
    0x65, 0x69, 0x67, 0x68, 0x74, 0x00, 0x00, 0x00, 0x8a, 0xfd, 0xff, 0xff,
    0x10, 0x00, 0x00, 0x00, 0x38, 0x00, 0x00, 0x00, 0x00, 0x00, 0x00, 0x09,
    0x24, 0x00, 0x00, 0x00, 0x7c, 0xfd, 0xff, 0xff, 0x08, 0x00, 0x00, 0x00,
    0x10, 0x00, 0x00, 0x00, 0x01, 0x00, 0x00, 0x00, 0x80, 0xff, 0xff, 0xff,
    0xff, 0xff, 0xff, 0xff, 0x01, 0x00, 0x00, 0x00, 0xb3, 0x8b, 0x0f, 0x3c,
    0x02, 0x00, 0x00, 0x00, 0x01, 0x00, 0x00, 0x00, 0x10, 0x00, 0x00, 0x00,
    0x0d, 0x00, 0x00, 0x00, 0x68, 0x69, 0x64, 0x64, 0x65, 0x6e, 0x2e, 0x6f,
    0x75, 0x74, 0x70, 0x75, 0x74, 0x00, 0x00, 0x00, 0xf6, 0xfe, 0xff, 0xff,
    0x14, 0x00, 0x00, 0x00, 0xf0, 0x00, 0x00, 0x00, 0x02, 0x00, 0x00, 0x00,
    0x00, 0x00, 0x00, 0x02, 0xdc, 0x00, 0x00, 0x00, 0xd4, 0xfd, 0xff, 0xff,
    0x08, 0x00, 0x00, 0x00, 0x8c, 0x00, 0x00, 0x00, 0x10, 0x00, 0x00, 0x00,
    0x00, 0x00, 0x00, 0x00, 0x00, 0x00, 0x00, 0x00, 0x00, 0x00, 0x00, 0x00,
    0x00, 0x00, 0x00, 0x00, 0x00, 0x00, 0x00, 0x00, 0x00, 0x00, 0x00, 0x00,
    0x00, 0x00, 0x00, 0x00, 0x00, 0x00, 0x00, 0x00, 0x00, 0x00, 0x00, 0x00,
    0x00, 0x00, 0x00, 0x00, 0x00, 0x00, 0x00, 0x00, 0x00, 0x00, 0x00, 0x00,
    0x00, 0x00, 0x00, 0x00, 0x00, 0x00, 0x00, 0x00, 0x00, 0x00, 0x00, 0x00,
    0x00, 0x00, 0x00, 0x00, 0x00, 0x00, 0x00, 0x00, 0x00, 0x00, 0x00, 0x00,
    0x00, 0x00, 0x00, 0x00, 0x00, 0x00, 0x00, 0x00, 0x00, 0x00, 0x00, 0x00,
    0x00, 0x00, 0x00, 0x00, 0x00, 0x00, 0x00, 0x00, 0x00, 0x00, 0x00, 0x00,
    0x00, 0x00, 0x00, 0x00, 0x00, 0x00, 0x00, 0x00, 0x00, 0x00, 0x00, 0x00,
    0x00, 0x00, 0x00, 0x00, 0x00, 0x00, 0x00, 0x00, 0x00, 0x00, 0x00, 0x00,
    0x00, 0x00, 0x00, 0x00, 0x00, 0x00, 0x00, 0x00, 0x00, 0x00, 0x00, 0x00,
    0x10, 0x00, 0x00, 0x00, 0x88, 0x83, 0x01, 0x38, 0x88, 0x83, 0x01, 0x38,
    0x88, 0x83, 0x01, 0x38, 0x88, 0x83, 0x01, 0x38, 0x88, 0x83, 0x01, 0x38,
    0x88, 0x83, 0x01, 0x38, 0x88, 0x83, 0x01, 0x38, 0x88, 0x83, 0x01, 0x38,
    0x88, 0x83, 0x01, 0x38, 0x88, 0x83, 0x01, 0x38, 0x88, 0x83, 0x01, 0x38,
    0x88, 0x83, 0x01, 0x38, 0x88, 0x83, 0x01, 0x38, 0x88, 0x83, 0x01, 0x38,
    0x88, 0x83, 0x01, 0x38, 0x88, 0x83, 0x01, 0x38, 0x01, 0x00, 0x00, 0x00,
    0x10, 0x00, 0x00, 0x00, 0x0b, 0x00, 0x00, 0x00, 0x68, 0x69, 0x64, 0x64,
    0x65, 0x6e, 0x2e, 0x62, 0x69, 0x61, 0x73, 0x00, 0x00, 0x00, 0x0e, 0x00,
    0x18, 0x00, 0x14, 0x00, 0x13, 0x00, 0x0c, 0x00, 0x08, 0x00, 0x04, 0x00,
    0x0e, 0x00, 0x00, 0x00, 0x14, 0x00, 0x00, 0x00, 0xf0, 0x00, 0x00, 0x00,
    0x01, 0x00, 0x00, 0x00, 0x00, 0x00, 0x00, 0x09, 0xd8, 0x00, 0x00, 0x00,
    0xec, 0xfe, 0xff, 0xff, 0x08, 0x00, 0x00, 0x00, 0x88, 0x00, 0x00, 0x00,
    0x10, 0x00, 0x00, 0x00, 0x00, 0x00, 0x00, 0x00, 0x00, 0x00, 0x00, 0x00,
    0x00, 0x00, 0x00, 0x00, 0x00, 0x00, 0x00, 0x00, 0x00, 0x00, 0x00, 0x00,
    0x00, 0x00, 0x00, 0x00, 0x00, 0x00, 0x00, 0x00, 0x00, 0x00, 0x00, 0x00,
    0x00, 0x00, 0x00, 0x00, 0x00, 0x00, 0x00, 0x00, 0x00, 0x00, 0x00, 0x00,
    0x00, 0x00, 0x00, 0x00, 0x00, 0x00, 0x00, 0x00, 0x00, 0x00, 0x00, 0x00,
    0x00, 0x00, 0x00, 0x00, 0x00, 0x00, 0x00, 0x00, 0x00, 0x00, 0x00, 0x00,
    0x00, 0x00, 0x00, 0x00, 0x00, 0x00, 0x00, 0x00, 0x00, 0x00, 0x00, 0x00,
    0x00, 0x00, 0x00, 0x00, 0x00, 0x00, 0x00, 0x00, 0x00, 0x00, 0x00, 0x00,
    0x00, 0x00, 0x00, 0x00, 0x00, 0x00, 0x00, 0x00, 0x00, 0x00, 0x00, 0x00,
    0x00, 0x00, 0x00, 0x00, 0x00, 0x00, 0x00, 0x00, 0x00, 0x00, 0x00, 0x00,
    0x00, 0x00, 0x00, 0x00, 0x00, 0x00, 0x00, 0x00, 0x00, 0x00, 0x00, 0x00,
    0x10, 0x00, 0x00, 0x00, 0x04, 0x02, 0x81, 0x3b, 0x04, 0x02, 0x81, 0x3b,
    0x04, 0x02, 0x81, 0x3b, 0x04, 0x02, 0x81, 0x3b, 0x04, 0x02, 0x81, 0x3b,
    0x04, 0x02, 0x81, 0x3b, 0x04, 0x02, 0x81, 0x3b, 0x04, 0x02, 0x81, 0x3b,
    0x04, 0x02, 0x81, 0x3b, 0x04, 0x02, 0x81, 0x3b, 0x04, 0x02, 0x81, 0x3b,
    0x04, 0x02, 0x81, 0x3b, 0x04, 0x02, 0x81, 0x3b, 0x04, 0x02, 0x81, 0x3b,
    0x04, 0x02, 0x81, 0x3b, 0x04, 0x02, 0x81, 0x3b, 0x02, 0x00, 0x00, 0x00,
    0x10, 0x00, 0x00, 0x00, 0x20, 0x00, 0x00, 0x00, 0x0d, 0x00, 0x00, 0x00,
    0x68, 0x69, 0x64, 0x64, 0x65, 0x6e, 0x2e, 0x77, 0x65, 0x69, 0x67, 0x68,
    0x74, 0x00, 0x0e, 0x00, 0x14, 0x00, 0x10, 0x00, 0x0f, 0x00, 0x00, 0x00,
    0x08, 0x00, 0x04, 0x00, 0x0e, 0x00, 0x00, 0x00, 0x1c, 0x00, 0x00, 0x00,
    0x44, 0x00, 0x00, 0x00, 0x00, 0x00, 0x00, 0x09, 0x30, 0x00, 0x00, 0x00,
    0x0c, 0x00, 0x0c, 0x00, 0x00, 0x00, 0x00, 0x00, 0x08, 0x00, 0x04, 0x00,
    0x0c, 0x00, 0x00, 0x00, 0x08, 0x00, 0x00, 0x00, 0x10, 0x00, 0x00, 0x00,
    0x01, 0x00, 0x00, 0x00, 0xff, 0xff, 0xff, 0xff, 0xff, 0xff, 0xff, 0xff,
    0x01, 0x00, 0x00, 0x00, 0x81, 0x80, 0x00, 0x3c, 0x02, 0x00, 0x00, 0x00,
    0x01, 0x00, 0x00, 0x00, 0x20, 0x00, 0x00, 0x00, 0x05, 0x00, 0x00, 0x00,
    0x69, 0x6e, 0x70, 0x75, 0x74, 0x00, 0x00, 0x00, 0x4a, 0xff, 0xff, 0xff,
    0x04, 0x00, 0x00, 0x00, 0x10, 0x00, 0x00, 0x00, 0x00, 0x00, 0x00, 0x00,
    0xfd, 0x10, 0x00, 0x00, 0x03, 0xef, 0xff, 0xff, 0x7e, 0x08, 0x00, 0x00,
    0x66, 0xff, 0xff, 0xff, 0x04, 0x00, 0x00, 0x00, 0x40, 0x00, 0x00, 0x00,
    0x81, 0x9a, 0xb4, 0xcd, 0xe7, 0x00, 0x19, 0x33, 0x4c, 0x66, 0x7f, 0x81,
    0x9a, 0xb4, 0xcd, 0xe7, 0x00, 0x19, 0x33, 0x4c, 0x66, 0x7f, 0x81, 0x9a,
    0xb4, 0xcd, 0xe7, 0x00, 0x19, 0x33, 0x4c, 0x66, 0x7f, 0x81, 0x9a, 0xb4,
    0xcd, 0xe7, 0x00, 0x19, 0x33, 0x4c, 0x66, 0x7f, 0x81, 0x9a, 0xb4, 0xcd,
    0xe7, 0x00, 0x19, 0x33, 0x4c, 0x66, 0x7f, 0x81, 0x9a, 0xb4, 0xcd, 0xe7,
    0x00, 0x19, 0x33, 0x4c, 0xb2, 0xff, 0xff, 0xff, 0x04, 0x00, 0x00, 0x00,
    0x40, 0x00, 0x00, 0x00, 0x30, 0xf0, 0xff, 0xff, 0x4c, 0xf2, 0xff, 0xff,
    0x67, 0xf4, 0xff, 0xff, 0x83, 0xf6, 0xff, 0xff, 0x9f, 0xf8, 0xff, 0xff,
    0xbb, 0xfa, 0xff, 0xff, 0xd6, 0xfc, 0xff, 0xff, 0xf2, 0xfe, 0xff, 0xff,
    0x0e, 0x01, 0x00, 0x00, 0x2a, 0x03, 0x00, 0x00, 0x45, 0x05, 0x00, 0x00,
    0x61, 0x07, 0x00, 0x00, 0x7d, 0x09, 0x00, 0x00, 0x99, 0x0b, 0x00, 0x00,
    0xb4, 0x0d, 0x00, 0x00, 0xd0, 0x0f, 0x00, 0x00, 0x00, 0x00, 0x06, 0x00,
    0x08, 0x00, 0x04, 0x00, 0x06, 0x00, 0x00, 0x00, 0x04, 0x00, 0x00, 0x00,
    0x00, 0x02, 0x00, 0x00, 0x81, 0x91, 0xa1, 0xb1, 0xc0, 0xd0, 0xe0, 0xf0,
    0x00, 0x10, 0x20, 0x30, 0x40, 0x4f, 0x5f, 0x6f, 0x7f, 0x81, 0x91, 0xa1,
    0xb1, 0xc0, 0xd0, 0xe0, 0xf0, 0x00, 0x10, 0x20, 0x30, 0x40, 0x4f, 0x5f,
    0x6f, 0x7f, 0x81, 0x91, 0xa1, 0xb1, 0xc0, 0xd0, 0xe0, 0xf0, 0x00, 0x10,
    0x20, 0x30, 0x40, 0x4f, 0x5f, 0x6f, 0x7f, 0x81, 0x91, 0xa1, 0xb1, 0xc0,
    0xd0, 0xe0, 0xf0, 0x00, 0x10, 0x20, 0x30, 0x40, 0x4f, 0x5f, 0x6f, 0x7f,
    0x81, 0x91, 0xa1, 0xb1, 0xc0, 0xd0, 0xe0, 0xf0, 0x00, 0x10, 0x20, 0x30,
    0x40, 0x4f, 0x5f, 0x6f, 0x7f, 0x81, 0x91, 0xa1, 0xb1, 0xc0, 0xd0, 0xe0,
    0xf0, 0x00, 0x10, 0x20, 0x30, 0x40, 0x4f, 0x5f, 0x6f, 0x7f, 0x81, 0x91,
    0xa1, 0xb1, 0xc0, 0xd0, 0xe0, 0xf0, 0x00, 0x10, 0x20, 0x30, 0x40, 0x4f,
    0x5f, 0x6f, 0x7f, 0x81, 0x91, 0xa1, 0xb1, 0xc0, 0xd0, 0xe0, 0xf0, 0x00,
    0x10, 0x20, 0x30, 0x40, 0x4f, 0x5f, 0x6f, 0x7f, 0x81, 0x91, 0xa1, 0xb1,
    0xc0, 0xd0, 0xe0, 0xf0, 0x00, 0x10, 0x20, 0x30, 0x40, 0x4f, 0x5f, 0x6f,
    0x7f, 0x81, 0x91, 0xa1, 0xb1, 0xc0, 0xd0, 0xe0, 0xf0, 0x00, 0x10, 0x20,
    0x30, 0x40, 0x4f, 0x5f, 0x6f, 0x7f, 0x81, 0x91, 0xa1, 0xb1, 0xc0, 0xd0,
    0xe0, 0xf0, 0x00, 0x10, 0x20, 0x30, 0x40, 0x4f, 0x5f, 0x6f, 0x7f, 0x81,
    0x91, 0xa1, 0xb1, 0xc0, 0xd0, 0xe0, 0xf0, 0x00, 0x10, 0x20, 0x30, 0x40,
    0x4f, 0x5f, 0x6f, 0x7f, 0x81, 0x91, 0xa1, 0xb1, 0xc0, 0xd0, 0xe0, 0xf0,
    0x00, 0x10, 0x20, 0x30, 0x40, 0x4f, 0x5f, 0x6f, 0x7f, 0x81, 0x91, 0xa1,
    0xb1, 0xc0, 0xd0, 0xe0, 0xf0, 0x00, 0x10, 0x20, 0x30, 0x40, 0x4f, 0x5f,
    0x6f, 0x7f, 0x81, 0x91, 0xa1, 0xb1, 0xc0, 0xd0, 0xe0, 0xf0, 0x00, 0x10,
    0x20, 0x30, 0x40, 0x4f, 0x5f, 0x6f, 0x7f, 0x81, 0x91, 0xa1, 0xb1, 0xc0,
    0xd0, 0xe0, 0xf0, 0x00, 0x10, 0x20, 0x30, 0x40, 0x4f, 0x5f, 0x6f, 0x7f,
    0x81, 0x91, 0xa1, 0xb1, 0xc0, 0xd0, 0xe0, 0xf0, 0x00, 0x10, 0x20, 0x30,
    0x40, 0x4f, 0x5f, 0x6f, 0x7f, 0x81, 0x91, 0xa1, 0xb1, 0xc0, 0xd0, 0xe0,
    0xf0, 0x00, 0x10, 0x20, 0x30, 0x40, 0x4f, 0x5f, 0x6f, 0x7f, 0x81, 0x91,
    0xa1, 0xb1, 0xc0, 0xd0, 0xe0, 0xf0, 0x00, 0x10, 0x20, 0x30, 0x40, 0x4f,
    0x5f, 0x6f, 0x7f, 0x81, 0x91, 0xa1, 0xb1, 0xc0, 0xd0, 0xe0, 0xf0, 0x00,
    0x10, 0x20, 0x30, 0x40, 0x4f, 0x5f, 0x6f, 0x7f, 0x81, 0x91, 0xa1, 0xb1,
    0xc0, 0xd0, 0xe0, 0xf0, 0x00, 0x10, 0x20, 0x30, 0x40, 0x4f, 0x5f, 0x6f,
    0x7f, 0x81, 0x91, 0xa1, 0xb1, 0xc0, 0xd0, 0xe0, 0xf0, 0x00, 0x10, 0x20,
    0x30, 0x40, 0x4f, 0x5f, 0x6f, 0x7f, 0x81, 0x91, 0xa1, 0xb1, 0xc0, 0xd0,
    0xe0, 0xf0, 0x00, 0x10, 0x20, 0x30, 0x40, 0x4f, 0x5f, 0x6f, 0x7f, 0x81,
    0x91, 0xa1, 0xb1, 0xc0, 0xd0, 0xe0, 0xf0, 0x00, 0x10, 0x20, 0x30, 0x40,
    0x4f, 0x5f, 0x6f, 0x7f, 0x81, 0x91, 0xa1, 0xb1, 0xc0, 0xd0, 0xe0, 0xf0,
    0x00, 0x10, 0x20, 0x30, 0x40, 0x4f, 0x5f, 0x6f, 0x7f, 0x81, 0x91, 0xa1,
    0xb1, 0xc0, 0xd0, 0xe0, 0xf0, 0x00, 0x10, 0x20, 0x30, 0x40, 0x4f, 0x5f,
    0x6f, 0x7f, 0x81, 0x91, 0xa1, 0xb1, 0xc0, 0xd0, 0xe0, 0xf0, 0x00, 0x10,
    0x20, 0x30, 0x40, 0x4f, 0x5f, 0x6f, 0x7f, 0x81, 0x91, 0xa1, 0xb1, 0xc0,
    0xd0, 0xe0, 0xf0, 0x00, 0x10, 0x20, 0x30, 0x40, 0x4f, 0x5f, 0x6f, 0x7f,
    0x81, 0x91, 0xa1, 0xb1, 0xc0, 0xd0, 0xe0, 0xf0, 0x00, 0x10, 0x20, 0x30,
    0x40, 0x4f, 0x5f, 0x6f, 0x7f, 0x81, 0x91, 0xa1, 0xb1, 0xc0, 0xd0, 0xe0,
    0xf0, 0x00, 0x10, 0x20, 0x30, 0x40, 0x4f, 0x5f, 0x6f, 0x7f, 0x81, 0x91,
    0x04, 0x00, 0x04, 0x00, 0x04, 0x00, 0x00, 0x00
};
const unsigned int tflm_model_data_len = 2168u;
const unsigned int tflm_model_input_count = 32u;
const unsigned int tflm_model_output_count = 4u;
const unsigned int tflm_model_arena_size = 1024u;
```

## src/model_data.h
```c
#ifndef BAKENN_TFLM_MODEL_DATA_H_
#define BAKENN_TFLM_MODEL_DATA_H_

extern const unsigned char tflm_model_data[];
extern const unsigned int tflm_model_data_len;
extern const unsigned int tflm_model_input_count;
extern const unsigned int tflm_model_output_count;
extern const unsigned int tflm_model_arena_size;

#endif
```
